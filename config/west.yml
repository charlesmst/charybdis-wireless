## config/west.yml
```yaml
manifest:
  defaults:
    remote: urob
    revision: v0.2
  remotes:
    - name: zmkfirmware
      url-base: https://github.com/charlesmst
    - name: inorichi
      url-base: https://github.com/inorichi
    - name: charlesmst
      url-base: https://github.com/charlesmst
    - name: urob
      url-base: https://github.com/urob
  projects:
    - name: zmk
      remote: zmkfirmware
      revision: main
      import: app/west.yml
    - name: zmk-pmw3610-driver
      remote: charlesmst
      revision: main
    - name: zmk-tri-state
      remote: urob
    - name: zephyr
      revision: v3.5.0+zmk-fixes
      clone-depth: 1
      import:
        # Only enable most commonly used boards. For less common hardware one
        # may need to enable additional modules.
        name-allowlist:
          - cmsis
          - hal_nordic
          - hal_rpi_pico
          - hal_stm32
          - lvgl
          - tinycrypt
  self:
    path: config
```
